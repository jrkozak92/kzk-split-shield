## boards/shields/kzksplit/Kconfig.defconfig
```kconfig
if SHIELD_KZKSPLIT_LEFT

config ZMK_KEYBOARD_NAME
    default "KZK Split"

config ZMK_SPLIT_ROLE_CENTRAL
    default y

endif

if SHIELD_KZKSPLIT_LEFT || SHIELD_KZKSPLIT_RIGHT

config ZMK_SPLIT
    default y

endif
```

## boards/shields/kzksplit/Kconfig.shield
```kconfig
config SHIELD_KZKSPLIT_LEFT
    def_bool $(shields_list_contains,kzksplit_left)

config SHIELD_KZKSPLIT_RIGHT
    def_bool $(shields_list_contains,kzksplit_right)
```

## config/boards/shields/kzk_split/kconfig.defconfig
```kconfig
if SHIELD_KZK_SPLIT_LEFT

config ZMK_KEYBOARD_NAME
    default "KZK Split"

config ZMK_SPLIT_ROLE_CENTRAL
    default y

endif

if SHIELD_KZK_SPLIT_LEFT || SHIELD_KZK_SPLIT_RIGHT

config ZMK_SPLIT
    default y

endif
```

## config/boards/shields/kzk_split/kconfig.shield
```kconfig
config SHIELD_KZK_SPLIT_LEFT
    def_bool $(shields_list_contains,kzk_split_left)

config SHIELD_KZK_SPLIT_RIGHT
    def_bool $(shields_list_contains,kzk_split_right)
```

## config/west.yml
```yaml
manifest:
  remotes:
    - name: zmkfirmware
      url-base: https://github.com/urob/zmk/tree/main-3.2
    # Additional modules containing boards/shields/custom code can be listed here as well
    # See https://docs.zephyrproject.org/3.2.0/develop/west/manifest.html#projects
  projects:
    - name: zmk
      remote: zmkfirmware
      revision: main
      import: app/west.yml
  self:
    path: config
```
